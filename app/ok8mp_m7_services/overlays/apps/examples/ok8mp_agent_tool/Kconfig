## app/ok8mp_m7_services/overlays/apps/examples/ok8mp_agent_tool/Kconfig
```kconfig
config EXAMPLES_OK8MP_AGENT_TOOL
	tristate "OK8MP Agent hardware Tool bridge"
	default n
	depends on OK8MP_M7_VOICE_I2C && UORB
	---help---
		Expose the OK8MP voice sensor, RGB LED and buzzer through a small
		C Tool registry.  This is the hardware-facing adapter intended to be
		connected to the official openvela Agent registration API when that
		framework is available in the workspace.

if EXAMPLES_OK8MP_AGENT_TOOL

config EXAMPLES_OK8MP_AGENT_TOOL_PROGNAME
	string "Program name"
	default "agent_tool"

config EXAMPLES_OK8MP_AGENT_TOOL_PRIORITY
	int "Task priority"
	default 100

config EXAMPLES_OK8MP_AGENT_TOOL_STACKSIZE
	int "Task stack size"
	default 4096

endif
```

## app/ok8mp_m7_services/overlays/apps/examples/ok8mp_can_diagnostic/Kconfig
```kconfig
#
# apps/examples/ok8mp_can_diagnostic/Kconfig
#

config EXAMPLES_OK8MP_CAN_DIAGNOSTIC
	tristate "OK8MP M7 CAN active diagnostic"
	default n
	depends on CAN && EXAMPLES_OK8MP_CAN_SERVICE
	---help---
		Send one project-defined classic-CAN diagnostic request and wait for
		the simulated ECU response.  The shared can_service routes the reply
		to this command without pausing the periodic health monitor.  It does
		not access CAN during board boot.

if EXAMPLES_OK8MP_CAN_DIAGNOSTIC

config EXAMPLES_OK8MP_CAN_DIAGNOSTIC_PROGNAME
	string "Program name"
	default "can_diagnostic"

config EXAMPLES_OK8MP_CAN_DIAGNOSTIC_DEVPATH
	string "CAN device path"
	default "/dev/can0"

config EXAMPLES_OK8MP_CAN_DIAGNOSTIC_REQUEST_ID
	hex "Diagnostic request standard CAN identifier"
	default 0x700
	range 0x0 0x7ff

config EXAMPLES_OK8MP_CAN_DIAGNOSTIC_RESPONSE_ID
	hex "Diagnostic response standard CAN identifier"
	default 0x708
	range 0x0 0x7ff

config EXAMPLES_OK8MP_CAN_DIAGNOSTIC_TIMEOUT_MS
	int "ECU response timeout (ms)"
	default 1000
	range 100 10000

endif
```

## app/ok8mp_m7_services/overlays/apps/examples/ok8mp_can_ecu/Kconfig
```kconfig
#
# apps/examples/ok8mp_can_ecu/Kconfig
#

config EXAMPLES_OK8MP_CAN_ECU
	tristate "OK8MP simulated ECU state and DTC client"
	default n
	depends on EXAMPLES_OK8MP_CAN_SERVICE
	---help---
		Query and control the ESP32 simulated ECU over ISO-TP, inspect the
		P0217/P0562 DTC model and run a multi-frame transport self-test.

if EXAMPLES_OK8MP_CAN_ECU

config EXAMPLES_OK8MP_CAN_ECU_PROGNAME
	string "Program name"
	default "can_ecu"

config EXAMPLES_OK8MP_CAN_ECU_REQUEST_ID
	hex "ISO-TP physical request CAN ID"
	default 0x7e0

config EXAMPLES_OK8MP_CAN_ECU_RESPONSE_ID
	hex "ISO-TP physical response CAN ID"
	default 0x7e8

config EXAMPLES_OK8MP_CAN_ECU_TIMEOUT_MS
	int "ISO-TP transaction timeout (ms)"
	default 2000
	range 100 10000

endif
```

## app/ok8mp_m7_services/overlays/apps/examples/ok8mp_can_monitor/Kconfig
```kconfig
#
# apps/examples/ok8mp_can_monitor/Kconfig
#

config EXAMPLES_OK8MP_CAN_MONITOR
	tristate "OK8MP M7 CAN health monitor"
	default n
	depends on CAN && EXAMPLES_OK8MP_CAN_SERVICE
	---help---
		Run a persistent monitor for a periodic classic-CAN status frame.
		The monitor checks the expected standard identifier, frame period,
		16-bit sequence counter and reception timeout.  It is started from
		NSH and does not access the CAN peripheral during board boot.

if EXAMPLES_OK8MP_CAN_MONITOR

config EXAMPLES_OK8MP_CAN_MONITOR_PROGNAME
	string "Program name"
	default "can_monitor"

config EXAMPLES_OK8MP_CAN_MONITOR_PRIORITY
	int "Monitor task priority"
	default 100

config EXAMPLES_OK8MP_CAN_MONITOR_STACKSIZE
	int "Monitor task stack size"
	default 3072

config EXAMPLES_OK8MP_CAN_MONITOR_DEVPATH
	string "CAN device path"
	default "/dev/can0"

config EXAMPLES_OK8MP_CAN_MONITOR_EXPECTED_ID
	hex "Expected standard CAN identifier"
	default 0x180
	range 0x0 0x7ff

config EXAMPLES_OK8MP_CAN_MONITOR_EXPECTED_PERIOD_MS
	int "Expected status-frame period (ms)"
	default 1000
	range 10 60000

config EXAMPLES_OK8MP_CAN_MONITOR_PERIOD_TOLERANCE_MS
	int "Allowed period deviation (ms)"
	default 400
	range 0 60000

config EXAMPLES_OK8MP_CAN_MONITOR_TIMEOUT_MS
	int "ECU reception timeout (ms)"
	default 3000
	range 100 600000

config EXAMPLES_OK8MP_CAN_MONITOR_POLL_MS
	int "CAN poll interval (ms)"
	default 100
	range 10 1000

endif
```

## app/ok8mp_m7_services/overlays/apps/examples/ok8mp_can_service/Kconfig
```kconfig
#
# apps/examples/ok8mp_can_service/Kconfig
#

config EXAMPLES_OK8MP_CAN_SERVICE
	tristate "OK8MP M7 shared CAN service"
	default n
	depends on CAN && OK8MP_M7_FLEXCAN1
	---help---
		Own /dev/can0 in one task, route frames to filtered subscribers,
		serialize transmission, expose controller statistics and recover a
		bus-off controller without rebooting M7.

if EXAMPLES_OK8MP_CAN_SERVICE

config EXAMPLES_OK8MP_CAN_SERVICE_PROGNAME
	string "Program name"
	default "can_service"

config EXAMPLES_OK8MP_CAN_SERVICE_PRIORITY
	int "Service task priority"
	default 110

config EXAMPLES_OK8MP_CAN_SERVICE_STACKSIZE
	int "Service task stack size"
	default 4096

config EXAMPLES_OK8MP_CAN_SERVICE_DEVPATH
	string "CAN device path"
	default "/dev/can0"

config EXAMPLES_OK8MP_CAN_SERVICE_POLL_MS
	int "Receive/status poll interval (ms)"
	default 10
	range 1 100

config EXAMPLES_OK8MP_CAN_SERVICE_AUTO_RECOVER_MS
	int "Minimum interval between bus-off recoveries (ms)"
	default 1000
	range 100 60000

endif
```

## app/ok8mp_m7_services/overlays/apps/examples/ok8mp_fec_probe/Kconfig
```kconfig
config EXAMPLES_OK8MP_FEC_PROBE
	tristate "OK8MP M7 FEC PHY probe"
	default n
	help
		Build the fec_probe command.  It reads the YT8521 PHY through the
		OK8MP ENET1/FEC MDIO interface without starting the network stack.

if EXAMPLES_OK8MP_FEC_PROBE

config EXAMPLES_OK8MP_FEC_PROBE_PROGNAME
	string "Program name"
	default "fec_probe"

config EXAMPLES_OK8MP_FEC_PROBE_PRIORITY
	int "FEC probe task priority"
	default 100

config EXAMPLES_OK8MP_FEC_PROBE_STACKSIZE
	int "FEC probe stack size"
	default DEFAULT_TASK_STACKSIZE

endif
```

## app/ok8mp_m7_services/overlays/apps/examples/ok8mp_https/Kconfig
```kconfig
config EXAMPLES_OK8MP_HTTPS
	tristate "OK8MP HTTPS and LLM API client"
	default n
	depends on CRYPTO_MBEDTLS && NET_TCP && LIBC_NETDB
	---help---
		Test DNS, TCP, TLS, HTTPS GET and OpenAI-compatible chat APIs.

if EXAMPLES_OK8MP_HTTPS

config EXAMPLES_OK8MP_HTTPS_PROGNAME
	string "Program name"
	default "https_client"

config EXAMPLES_OK8MP_HTTPS_PRIORITY
	int "Task priority"
	default 100

config EXAMPLES_OK8MP_HTTPS_STACKSIZE
	int "Task stack size"
	default 32768

config EXAMPLES_OK8MP_HTTPS_TIMEOUT
	int "Socket timeout in seconds"
	default 30

config EXAMPLES_OK8MP_HTTPS_REQUIRE_TIME
	bool "Reject TLS when system time is invalid"
	default y
	help
		Require a sane wall clock before certificate validation.  Run the
		NTP client after networking is configured and before HTTPS.

config EXAMPLES_OK8MP_HTTPS_LOG_PATH
	string "Default request/response log path"
	default "/tmp/llm_api.log"
	help
		Append HTTPS request metadata and responses to this file.  API keys
		are never logged.  Set LLM_LOG_PATH=none to disable logging or set it
		to another writable path at runtime.

endif
```

## app/ok8mp_m7_services/overlays/apps/examples/ok8mp_voice_uorb/Kconfig
```kconfig
config EXAMPLES_OK8MP_VOICE_UORB
	tristate "OK8MP voice sensor uORB bridge"
	default n
	depends on UORB && OK8MP_M7_VOICE_I2C
	---help---
		Publish voice recognition results to the sensor_voice_command uORB
		topic and optionally map the built-in color command IDs to RGB.

if EXAMPLES_OK8MP_VOICE_UORB

config EXAMPLES_OK8MP_VOICE_UORB_PROGNAME
	string "Program name"
	default "voice_uorb"

config EXAMPLES_OK8MP_VOICE_UORB_PRIORITY
	int "Bridge task priority"
	default 100

config EXAMPLES_OK8MP_VOICE_UORB_STACKSIZE
	int "Bridge task stack size"
	default 4096

config EXAMPLES_OK8MP_VOICE_UORB_POLL_MS
	int "Voice sensor poll interval (ms)"
	default 100
	range 20 5000

config EXAMPLES_OK8MP_VOICE_UORB_RGB_FEEDBACK
	bool "Map command IDs 1..4 to red/green/blue/off"
	default y

endif
```

## board/ok8mp_m7_openvela/Kconfig
```kconfig
# SPDX-License-Identifier: Apache-2.0

#
# For a description of the syntax of this configuration file,
# see the file kconfig-language.txt in the NuttX tools repository.
#

config MX8MP_RUN_FROM_ITCM
	bool "Run from Instruction Tightly Coupled Memory (ITCM)"
	default n
	---help---
		Run software from ITCM instead of DDR memory

config OK8MP_M7_VOICE_I2C
	bool "OK8MP M7 I2C voice sensor"
	default n
	depends on I2C
	---help---
		Enable a simple OK8MP-M7 board-level I2C voice sensor driver.
		The driver registers /dev/voicesensor0 and reads one sensor
		status register through the configured I2C bus.

if OK8MP_M7_VOICE_I2C

config OK8MP_M7_VOICE_I2C_BUS
	int "Voice sensor I2C bus"
	default 3
	range 1 6

config OK8MP_M7_VOICE_I2C_ADDR
	hex "Voice sensor I2C address"
	default 0x0f

config OK8MP_M7_VOICE_I2C_REG
	hex "Voice sensor status register"
	default 0x08

config OK8MP_M7_VOICE_I2C_FREQ
	int "Voice sensor I2C frequency"
	default 100000

endif

config OK8MP_M7_FEC_PROBE
	bool "OK8MP M7 FEC MDIO PHY probe"
	default n
	help
		Enable the board-level FEC MDIO probe for the Ethernet port wired to
		ENET1/FEC at 0x30be0000.  The probe resets the YT8521 PHY and reads
		its Clause 22 registers.  It also provides the low-level diagnostic
		command used while bringing up the direct M7 Ethernet path.

config OK8MP_M7_FEC_NET
	bool "OK8MP M7 ENET1/FEC NuttX network driver"
	default n
	depends on NET && NET_ETHERNET && NET_IPv4 && NET_ARP
	---help---
		Register the OK8MP ENET1/FEC controller as a NuttX Ethernet device.
		The driver reuses the verified YT8521/RGMII setup and OCRAM DMA rings,
		then presents them through struct net_driver_s as eth0.  The first
		implementation uses polling intentionally; it is a stable foundation
		for IPv4, ARP, ICMP, DHCP and TCP before FEC IRQ handling is enabled.

config OK8MP_M7_FLEXCAN1
	bool "OK8MP M7 native CAN1 character device"
	default n
	select MX8MP_FLEXCAN
	select MX8MP_FLEXCAN1
	---help---
		Configure the board's native, isolated CAN1 interface and register
		the NuttX character device /dev/can0.  The initial implementation is
		classic CAN (CAN 2.0), intended to interoperate with a 500 kbit/s
		ESP32 TWAI test ECU.  It does not enable CAN FD.

if OK8MP_M7_FLEXCAN1

config OK8MP_M7_FLEXCAN1_BITRATE
	int "CAN1 nominal bitrate"
	default 500000
	range 125000 1000000
	---help---
		Nominal classic CAN bitrate in bit/s.  The default uses the 24 MHz
		CAN root clock with a 12 time-quanta, 500 kbit/s setup.

endif # OK8MP_M7_FLEXCAN1

config OK8MP_M7_HEARTBEAT
	bool "OK8MP M7 heartbeat task"
	default n
	---help---
		Start a tiny background task that prints a heartbeat periodically.
		This is useful for validating whether the M7 keeps running after
		the A53 Linux kernel boots.

if OK8MP_M7_HEARTBEAT

config OK8MP_M7_HEARTBEAT_INTERVAL
	int "Heartbeat interval in seconds"
	default 2
	range 1 60

config OK8MP_M7_HEARTBEAT_PRIORITY
	int "Heartbeat task priority"
	default 80

config OK8MP_M7_HEARTBEAT_STACKSIZE
	int "Heartbeat task stack size"
	default 1024

endif
```

## firmware/xts/xts-nist/defconfig
```kconfig
CONFIG_ALLOW_MIT_COMPONENTS=y
CONFIG_ARCH="arm"
CONFIG_ARCH_BOARD="ok8mp-m7"
CONFIG_ARCH_CHIP="mx8mp"
CONFIG_BASE_DEFCONFIG="ok8mp-m7:nsh-agent-dirty"
CONFIG_INTELHEX_BINARY=y
CONFIG_RAW_BINARY=y
CONFIG_ARCH_SETJMP_H=y
CONFIG_ARCH_CHIP_MX8MP=y
CONFIG_ARM_MPU=y
CONFIG_DEBUG_HARDFAULT_ALERT=y
CONFIG_DEBUG_BUSFAULT=y
CONFIG_ARMV7M_ICACHE=y
CONFIG_ARMV7M_DCACHE=y
CONFIG_ARMV7M_DCACHE_WRITETHROUGH=y
CONFIG_MX8MP_UART4=y
CONFIG_MX8MP_I2C=y
CONFIG_MX8MP_I2C3=y
CONFIG_MX8MP_I2C_DRIVER=y
CONFIG_ARCH_STACKDUMP=y
# CONFIG_ARCH_RAMFUNCS is not set
CONFIG_BOARD_LOOPSPERMSEC=159972
CONFIG_ARCH_INTERRUPTSTACK=2048
CONFIG_RAM_START=0x80100000
CONFIG_RAM_SIZE=15728640
CONFIG_ARCH_BOARD_OK8MP_M7=y
# CONFIG_ARCH_LEDS is not set
CONFIG_OK8MP_M7_VOICE_I2C=y
CONFIG_OK8MP_M7_FEC_NET=y
CONFIG_START_YEAR=2014
CONFIG_START_MONTH=3
CONFIG_START_DAY=10
CONFIG_PREALLOC_TIMERS=4
CONFIG_INIT_ENTRYPOINT="nsh_main"
CONFIG_RR_INTERVAL=200
CONFIG_SCHED_HAVE_PARENT=y
CONFIG_SCHED_CHILD_STATUS=y
CONFIG_PTHREAD_MUTEX_TYPES=y
CONFIG_SCHED_HPWORK=y
CONFIG_SCHED_LPWORK=y
CONFIG_DEV_URANDOM=y
CONFIG_DEV_URANDOM_RANDOM_POOL=y
CONFIG_I2C_RESET=y
CONFIG_USERLED=y
CONFIG_USERLED_LOWER=y
CONFIG_SENSORS=y
CONFIG_USENSOR=y
# CONFIG_STANDARD_SERIAL is not set
CONFIG_UART4_SERIAL_CONSOLE=y
CONFIG_NET=y
CONFIG_NET_ETH_PKTSIZE=1514
CONFIG_NET_GUARDSIZE=4
CONFIG_NETDEV_LATEINIT=y
CONFIG_NET_LOCAL=y
CONFIG_NET_TCP=y
CONFIG_NET_TCP_WRITE_BUFFERS=y
CONFIG_NET_UDP=y
CONFIG_NET_BROADCAST=y
CONFIG_NET_UDP_WRITE_BUFFERS=y
CONFIG_NET_ICMP_SOCKET=y
CONFIG_NET_ROUTE=y
CONFIG_CRYPTO=y
CONFIG_CRYPTO_RANDOM_POOL=y
CONFIG_PSEUDOFS_SOFTLINKS=y
CONFIG_FS_TMPFS=y
CONFIG_FS_PROCFS=y
CONFIG_IOB_NBUFFERS=128
CONFIG_IOB_NCHAINS=4
CONFIG_LIBC_SCANSET=y
CONFIG_LINE_MAX=64
CONFIG_TLS_NELEM=4
CONFIG_TLS_TASK_NELEM=4
CONFIG_NETDB_DNSCLIENT=y
CONFIG_NETDB_DNSCLIENT_RETRIES=2
CONFIG_NETDB_DNSSERVER_IPv4ADDR=0x01010101
CONFIG_BUILTIN=y
CONFIG_LIBM=y
CONFIG_EXAMPLES_HELLO=y
CONFIG_EXAMPLES_OK8MP_GPIO_TEST=y
CONFIG_EXAMPLES_OK8MP_NET_PROXY=y
CONFIG_EXAMPLES_OK8MP_TIMER_TEST=y
CONFIG_EXAMPLES_OK8MP_VOICE=y
CONFIG_EXAMPLES_OK8MP_VOICE_UORB=y
CONFIG_EXAMPLES_PIPE=y
CONFIG_EXAMPLES_POPEN=y
CONFIG_NETINIT_IPADDR=0xc0a80202
CONFIG_NETINIT_DRIPADDR=0xc0a80201
CONFIG_NETINIT_DNS=y
CONFIG_NETINIT_DNSIPADDR=0x01010101
CONFIG_NETUTILS_WEBCLIENT=y
CONFIG_NSH_READLINE=y
CONFIG_NSH_BUILTIN_APPS=y
# CONFIG_NSH_DISABLE_DATE is not set
CONFIG_NSH_FILEIOSIZE=512
CONFIG_SYSTEM_DHCPC_RENEW=y
CONFIG_SYSTEM_I2CTOOL=y
CONFIG_I2CTOOL_MINBUS=1
CONFIG_I2CTOOL_MAXBUS=6
CONFIG_I2CTOOL_MINADDR=0x00
CONFIG_I2CTOOL_MAXADDR=0x7f
CONFIG_SYSTEM_NSH=y
CONFIG_SYSTEM_NTPC=y
CONFIG_SYSTEM_PING=y
CONFIG_SYSTEM_POPEN=y
CONFIG_READLINE_CMD_HISTORY=y
CONFIG_SYSTEM_SYSTEM=y
CONFIG_UORB=y
CONFIG_UORB_STACKSIZE=8192
CONFIG_UORB_LISTENER=y
CONFIG_TESTING_FSTEST=y
CONFIG_TESTING_FSTEST_MOUNTPT="/tmp"
CONFIG_TESTING_SCANFTEST=y
CONFIG_TESTING_SCANFTEST_FNAME="/tmp/test.txt"
CONFIG_TESTING_RAMTEST=y
CONFIG_TESTING_NIST_STS=y
CONFIG_TESTING_OSTEST=y
CONFIG_TESTING_GETPRIME=y
```
